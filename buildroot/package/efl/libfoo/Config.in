## buildroot/package/efl/libfoo/Config.in
```kconfig
config BR2_PACKAGE_LIBFOO
	bool "libfoo"
	help
	  This is a comment that explains what libfoo is.
          http://foosoftware.org/libfoo/
```

## buildroot/package/webconn/Config.in
```kconfig
config BR2_PACKAGE_WEBCONN
	bool "webconn"
	help
	 This is a comment that explains what libfoo is.


	 http://foosoftware.org/libfoo/
```
